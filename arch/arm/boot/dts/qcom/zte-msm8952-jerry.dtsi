/* Copyright (c) 2014-2015, The Linux Foundation. All rights reserved.
 *
 * This program is free software; you can redistribute it and/or modify
 * it under the terms of the GNU General Public License version 2 and
 * only version 2 as published by the Free Software Foundation.
 *
 */
 #include "touch-key-backlight-jerry.dtsi"
 
&cci {
	qcom,camera@0 {
		cell-index = <0>;
		compatible = "qcom,camera";
		reg = <0x0>;
		qcom,csiphy-sd-index = <0>;
		qcom,csid-sd-index = <0>;
		qcom,mount-angle = <90>;
		qcom,eeprom-src = <&eeprom0>;
		qcom,actuator-src = <&actuator0>;
		qcom,led-flash-src = <&led_flash0>;
		cam_vdig-supply = <&pm8950_s3>;
		cam_vaf-supply = <&pm8950_l22>;
		cam_v_custom1-supply = <&pm8950_l23>;//s5k5e2-dvdd
		qcom,cam-vreg-name = "cam_vdig", "cam_vaf","cam_v_custom1";
		qcom,cam-vreg-min-voltage = <1325000  2800000 1200000>;
		qcom,cam-vreg-max-voltage = <1325000  2800000 1200000>;
		qcom,cam-vreg-op-mode = <200000  100000 100000>;
		pinctrl-names = "cam_default", "cam_suspend";
		pinctrl-0 = <&cam_sensor_mclk0_default
				&cam_sensor_rear_default>;
		pinctrl-1 = <&cam_sensor_mclk0_sleep &cam_sensor_rear_sleep>;
		gpios = <&msm_gpio 26 0>,
			<&msm_gpio 36 0>,
			<&msm_gpio 35 0>,
			<&msm_gpio 41 0>,
			<&msm_gpio 132 0>,
			<&msm_gpio 131 0>,
		       <&msm_gpio 34 0>,
		       <&msm_gpio 59 0>;
		qcom,gpio-reset = <1>;
		qcom,gpio-standby = <2>;
		qcom,gpio-vio = <3>;
		qcom,gpio-vdig = <4>;
		qcom,gpio-vana = <5>;
		qcom,gpio-flash-now = <6>;
		qcom,gpio-custom1 = <7>;
		qcom,gpio-req-tbl-num = <0 1 2 3 4 5 6 7>;
		qcom,gpio-req-tbl-flags = <1 0 0 0 0 0  0 0>;
		qcom,gpio-req-tbl-label = "CAMIF_MCLK0",
			"CAM_RESET0",
			"CAM_STANDBY0",
			"CAM_VIO0",
			"CAM_VDIG0",
			"CAM_VANA0",
		       "CAM_FLASH",
		       "FRONT_AVDD";
		qcom,sensor-position = <0>;/*0 means CAMERA_POSITION_BACK*/
		qcom,sensor-mode = <0>;
		qcom,cci-master = <0>;
		status = "ok";
		clocks = <&clock_gcc clk_mclk0_clk_src>,
				<&clock_gcc clk_gcc_camss_mclk0_clk>;
		clock-names = "cam_src_clk", "cam_clk";
	};
qcom,camera@1 {
		cell-index = <1>;
		qcom,sensor-name = "ov2685_scv3b4035";
		compatible = "ovti,ov2685_scv3b4035";
		qcom,slave-id= <0x78 0x300A 0x2685>;
		reg = <0x1>;
		qcom,csiphy-sd-index = <1>;
		qcom,csid-sd-index = <0>;
		qcom,mount-angle = <90>;
		cam_vdig-supply = <&pm8950_s3>;
		qcom,cam-vreg-name = "cam_vdig";
		qcom,cam-vreg-min-voltage = <1325000 >;
		qcom,cam-vreg-max-voltage = <1325000 >;
		qcom,cam-vreg-op-mode = <200000 >;
		pinctrl-names = "cam_default", "cam_suspend";
		pinctrl-0 = <&cam_sensor_mclk1_default &cam_sensor_front_default>;
		pinctrl-1 = <&cam_sensor_mclk1_sleep &cam_sensor_front_sleep>;
		gpios = <&msm_gpio 27 0>,
			<&msm_gpio 87 0>,
			<&msm_gpio 86 0>,
			<&msm_gpio 41 0>,
			<&msm_gpio 60 0>,
			<&msm_gpio 59 0>;
		qcom,gpio-reset = <1>;
		qcom,gpio-standby = <2>;
		qcom,gpio-vio = <3>;
		qcom,gpio-vdig = <4>;
		qcom,gpio-vana = <5>;
		qcom,gpio-req-tbl-num = <0 1 2 3 4 5 >;
		qcom,gpio-req-tbl-flags = <1 0 0 0 0 0 >;
		qcom,gpio-req-tbl-label = "CAMIF_MCLK1",
			"CAM_RESET1",
			"CAM_STANDBY1",
			"CAM_VIO1",
			"CAM_VDIG1",
			"CAM_VANA1";
		qcom,sensor-position = <2>;/*2 means CAMERA_POSITON_BACK_AUX*/
		qcom,sensor-mode = <0>;
		qcom,cci-master = <1>;
		qcom,csi-lane-assign = <0x4320>;
		qcom,csi-lane-mask = <0x3>;
		status = "ok";
		clocks = <&clock_gcc clk_mclk1_clk_src>,
				<&clock_gcc clk_gcc_camss_mclk1_clk>;
		clock-names = "cam_src_clk", "cam_clk";
	};

	qcom,camera@2 {
		cell-index = <2>;
		compatible = "qcom,camera";
		reg = <0x02>;
		qcom,csiphy-sd-index = <1>;
		qcom,csid-sd-index = <1>;
		qcom,mount-angle = <270>;
		qcom,actuator-src = <&actuator1>;
		/*qcom,eeprom-src = <&eeprom1>;*/
		cam_vdig-supply = <&pm8950_l23>;
		qcom,cam-vreg-name = "cam_vdig";
		qcom,cam-vreg-min-voltage = <1200000>;
		qcom,cam-vreg-max-voltage = <1200000>;
		qcom,cam-vreg-op-mode = <105000>;
		qcom,gpio-no-mux = <0>;
		pinctrl-names = "cam_default", "cam_suspend";
		pinctrl-0 = <&cam_sensor_mclk2_default &cam_sensor_front1_default>;
		pinctrl-1 = <&cam_sensor_mclk2_sleep &cam_sensor_front1_sleep>;
		gpios = <&msm_gpio 28 0>,
			<&msm_gpio 40 0>,
			<&msm_gpio 39 0>,
			<&msm_gpio 41 0>,
			<&msm_gpio 59 0>,
			<&msm_gpio 131 0>,
			<&msm_gpio 132 0>;
		qcom,gpio-reset = <1>;
		qcom,gpio-standby = <2>;
		qcom,gpio-vio = <3>;
		qcom,gpio-vana = <4>;
		qcom,gpio-custom1= <5>;
		qcom,gpio-custom2= <6>;
		qcom,gpio-req-tbl-num = <0 1 2 3 4 5 6>;
		qcom,gpio-req-tbl-flags = <1 0 0 0 0 0 0>;
		qcom,gpio-req-tbl-label = "CAMIF_MCLK2",
				      "CAM_RESET2",
				      "CAM_STANDBY2",
				      "CAM_VIO2",
            			      "CAM_VANA2",
            			      "BACK_AVDD",
            			      "BACK_DVDD";
		qcom,sensor-position = <1>;/*1 means CAMERA_POSITION_FRONT*/
		qcom,sensor-mode = <1>;
		qcom,cci-master = <0>;
		status = "ok";
		clocks = <&clock_gcc clk_mclk2_clk_src>,
			<&clock_gcc clk_gcc_camss_mclk2_clk>;
		clock-names = "cam_src_clk", "cam_clk";
	};
 	};
