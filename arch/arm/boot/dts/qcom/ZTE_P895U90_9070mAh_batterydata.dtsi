
qcom,zte_p895u90_9070mah_batterydata {
	/* #2466768_ZTE_P895U90_9070mAh_averaged_MasterSlave_Jun27th2016*/
	qcom,max-voltage-uv = <4400000>;
	qcom,nom-batt-capacity-mah = <9070>;
	qcom,batt-id-kohm = <180>;
	qcom,battery-beta = <4050>;
	qcom,battery-type = "ZTE_BATTERY_DATA_ID_1";
	qcom,chg-rslow-comp-c1 = <1934201>;
	qcom,chg-rslow-comp-c2 = <1127395>;
	qcom,chg-rs-to-rslow = <920812>;
	qcom,chg-rslow-comp-thr = <0x99>;
	qcom,checksum = <0x159A>;
	qcom,gui-version = "PMI8950GUI - 2.0.0.16";
	qcom,fg-profile-data = [
		 03 83 3E 70 
		 88 68 8A 53 
		 3C 83 5D 71 
		 7A 75 D6 6B 
		 B7 81 38 A0 
		 D3 BF 26 D1 
		 7D 0E 13 88 
		 2E 7F E4 82 
		 5D 7D 59 83 
		 74 57 7C 83 
		 0F 8F 3B 82 
		 B7 98 69 B6 
		 DA C1 58 18 
		 E2 24 D7 51 
		 14 70 8D F8 
		 30 47 02 46 
		 AF 49 00 00 
		 E5 47 8F 3A 
		 DE 2B 00 00 
		 00 00 00 00 
		 00 00 00 00 
		 6F 70 AB 6A 
		 4A 59 D2 82 
		 3B 76 00 69 
		 79 50 8C 7B 
		 A5 74 97 61 
		 A3 6F 27 A8 
		 21 3B 60 F8 
		 5D A0 71 0C 
		 28 00 FF 36 
		 F0 11 30 03 
		 00 00 00 0C 
	];
};
