/* Copyright (c) 2015, The Linux Foundation. All rights reserved.
 *
 * This program is free software; you can redistribute it and/or modify
 * it under the terms of the GNU General Public License version 2 and
 * only version 2 as published by the Free Software Foundation.
 *
 * This program is distributed in the hope that it will be useful,
 * but WITHOUT ANY WARRANTY; without even the implied warranty of
 * MERCHANTABILITY or FITNESS FOR A PARTICULAR PURPOSE.  See the
 * GNU General Public License for more details.
 */

&mdss_mdp {
	dsi_success_nt35695_auo_6p0_1080P_video_vid: qcom,mdss_dsi_success_nt35695_auo_6p0_1080p_video {
		qcom,mdss-dsi-panel-name = "zteSUCCESS(NT35695)AUO_1080*1920_6P0Inch";
		qcom,mdss-dsi-panel-type = "dsi_cmd_mode";
		qcom,cont-splash-enabled;
		qcom,mdss-dsi-panel-framerate = <60>;
		qcom,mdss-dsi-virtual-channel-id = <0>;
		qcom,mdss-dsi-stream = <0>;
		qcom,mdss-dsi-panel-width = <1080>;
		qcom,mdss-dsi-panel-height = <1920>;
		qcom,mdss-dsi-h-front-porch = <16>; 
		qcom,mdss-dsi-h-back-porch = <12>;
		qcom,mdss-dsi-h-pulse-width = <12>;
		qcom,mdss-dsi-h-sync-skew = <0>;
		qcom,mdss-dsi-v-back-porch = <4>;
		qcom,mdss-dsi-v-front-porch = <6>;
		qcom,mdss-dsi-v-pulse-width = <2>;
		qcom,mdss-dsi-h-left-border = <0>;
		qcom,mdss-dsi-h-right-border = <0>;
		qcom,mdss-dsi-v-top-border = <0>;
		qcom,mdss-dsi-v-bottom-border = <0>;
		qcom,mdss-dsi-bpp = <24>;
		qcom,mdss-dsi-underflow-color = <0xff>;
		qcom,mdss-dsi-border-color = <0>;
		qcom,mdss-dsi-h-sync-pulse = <0>;
		qcom,mdss-dsi-traffic-mode = "burst_mode";
		
		qcom,mdss-dsi-te-pin-select = <1>;
		qcom,mdss-dsi-te-dcs-command = <1>;
		qcom,mdss-dsi-te-check-enable;
		qcom,mdss-dsi-te-using-te-pin;
		qcom,mdss-dsi-wr-mem-start = <0x2c>;
		qcom,mdss-dsi-wr-mem-continue = <0x3c>;
		
		qcom,mdss-dsi-bllp-eof-power-mode;
		qcom,mdss-dsi-bllp-power-mode;
		qcom,mdss-dsi-lane-0-state;
		qcom,mdss-dsi-lane-1-state;
		qcom,mdss-dsi-lane-2-state;
		qcom,mdss-dsi-lane-3-state;
		qcom,mdss-dsi-panel-timings = [D2 30 20 00 5e 60 26 34 28 03 04 00];
		
		qcom,mdss-dsi-t-clk-post = <0x23>;// 03 ,23-383ns,nt35695 > 350ns
		qcom,mdss-dsi-t-clk-pre = <0x27>;
		qcom,mdss-dsi-bl-min-level = <1>;
		qcom,mdss-dsi-bl-max-level = <255>;
		qcom,mdss-dsi-dma-trigger = "trigger_sw";
		qcom,mdss-dsi-mdp-trigger = "none";
		qcom,mdss-dsi-on-command = [

39 01 00 00 00 00  02 FF 24 
39 01 00 00 00 00  02 FB 01 
39 01 00 00 00 00  02 FF 20 
39 01 00 00 00 00  02 00 01 
39 01 00 00 00 00  02 01 55 
39 01 00 00 00 00  02 02 45 
39 01 00 00 00 00  02 03 55 
39 01 00 00 00 00  02 05 40 
39 01 00 00 00 00  02 06 99 
39 01 00 00 00 00  02 07 9E 
39 01 00 00 00 00  02 08 0C 
39 01 00 00 00 00  02 0B 87 
39 01 00 00 00 00  02 0C 87 
39 01 00 00 00 00  02 0E AB 
39 01 00 00 00 00  02 0F A9 
39 01 00 00 00 00  02 11 0D 
39 01 00 00 00 00  02 12 10 
39 01 00 00 00 00  02 13 03 
39 01 00 00 00 00  02 14 4A 
39 01 00 00 00 00  02 15 12 
39 01 00 00 00 00  02 16 12 
39 01 00 00 00 00  02 30 01 
39 01 00 00 00 00  02 58 00 
39 01 00 00 00 00  02 59 00 
39 01 00 00 00 00  02 5A 02 
39 01 00 00 00 00  02 5B 00 
39 01 00 00 00 00  02 5C 00 
39 01 00 00 00 00  02 5D 00 
39 01 00 00 00 00  02 5E 02 
39 01 00 00 00 00  02 5F 02 
39 01 00 00 00 00  02 72 31 
39 01 00 00 00 00  02 FB 01 
39 01 00 00 00 00  02 FF 24 
39 01 00 00 00 00  02 00 01 
39 01 00 00 00 00  02 01 0B 
39 01 00 00 00 00  02 02 0C 
39 01 00 00 00 00  02 03 03 
39 01 00 00 00 00  02 04 05 
39 01 00 00 00 00  02 05 1C 
39 01 00 00 00 00  02 06 10 
39 01 00 00 00 00  02 07 00 
39 01 00 00 00 00  02 08 1C 
39 01 00 00 00 00  02 09 00 
39 01 00 00 00 00  02 0A 00 
39 01 00 00 00 00  02 0B 00 
39 01 00 00 00 00  02 0C 00 
39 01 00 00 00 00  02 0D 13 
39 01 00 00 00 00  02 0E 15 
39 01 00 00 00 00  02 0F 17 
39 01 00 00 00 00  02 10 01 
39 01 00 00 00 00  02 11 0B 
39 01 00 00 00 00  02 12 0C 
39 01 00 00 00 00  02 13 04 
39 01 00 00 00 00  02 14 06 
39 01 00 00 00 00  02 15 1C 
39 01 00 00 00 00  02 16 10 
39 01 00 00 00 00  02 17 00 
39 01 00 00 00 00  02 18 1C 
39 01 00 00 00 00  02 19 00 
39 01 00 00 00 00  02 1A 00 
39 01 00 00 00 00  02 1B 00 
39 01 00 00 00 00  02 1C 00 
39 01 00 00 00 00  02 1D 13 
39 01 00 00 00 00  02 1E 15 
39 01 00 00 00 00  02 1F 17 
39 01 00 00 00 00  02 20 00 
39 01 00 00 00 00  02 21 03 
39 01 00 00 00 00  02 22 01 
39 01 00 00 00 00  02 23 4A 
39 01 00 00 00 00  02 24 4A 
39 01 00 00 00 00  02 25 6D 
39 01 00 00 00 00  02 26 40 
39 01 00 00 00 00  02 27 40 
39 01 00 00 00 00  02 32 7B 
39 01 00 00 00 00  02 33 00 
39 01 00 00 00 00  02 34 01 
39 01 00 00 00 00  02 35 8E 
39 01 00 00 00 00  02 39 01 
39 01 00 00 00 00  02 3A 8E 
39 01 00 00 00 00  02 BD 20 
39 01 00 00 00 00  02 B6 22 
39 01 00 00 00 00  02 B7 24 
39 01 00 00 00 00  02 B8 07 
39 01 00 00 00 00  02 B9 07 
39 01 00 00 00 00  02 C1 6D 
39 01 00 00 00 00  02 C4 99 
39 01 00 00 00 00  02 BE 07 
39 01 00 00 00 00  02 BF 07 
39 01 00 00 00 00  02 29 D8 
39 01 00 00 00 00  02 2A 2A 
39 01 00 00 00 00  02 5B 43 
39 01 00 00 00 00  02 5C 00 
39 01 00 00 00 00  02 5F 73 
39 01 00 00 00 00  02 60 73 
39 01 00 00 00 00  02 63 22 
39 01 00 00 00 00  02 64 00 
39 01 00 00 00 00  02 67 08 
39 01 00 00 00 00  02 68 04 
39 01 00 00 00 00  02 7A 80 
39 01 00 00 00 00  02 7B 91 
39 01 00 00 00 00  02 7C D8 
39 01 00 00 00 00  02 7D 60 
39 01 00 00 00 00  02 74 09 
39 01 00 00 00 00  02 7E 09 
39 01 00 00 00 00  02 75 21 
39 01 00 00 00 00  02 7F 21 
39 01 00 00 00 00  02 76 05 
39 01 00 00 00 00  02 81 05 
39 01 00 00 00 00  02 77 04 
39 01 00 00 00 00  02 82 04 
39 01 00 00 00 00  02 93 06 
39 01 00 00 00 00  02 94 06 
39 01 00 00 00 00  02 B3 00 
39 01 00 00 00 00  02 B4 00 
39 01 00 00 00 00  02 B5 00 
39 01 00 00 00 00  02 78 00 
39 01 00 00 00 00  02 79 00 
39 01 00 00 00 00  02 80 00 
39 01 00 00 00 00  02 83 00 
39 01 00 00 00 00  02 84 04 
39 01 00 00 00 00  02 8A 33 
39 01 00 00 00 00  02 8B F0 
39 01 00 00 00 00  02 9B 0F 
39 01 00 00 00 00  02 C6 09 
39 01 00 00 00 00  02 FB 01 
39 01 00 00 00 00  02 EC 00 
39 01 00 00 00 00  02 FF 20 
39 01 00 00 00 00  02 FB 01 
39 01 00 00 00 00  02 75 00 
39 01 00 00 00 00  02 76 49 
39 01 00 00 00 00  02 77 00 
39 01 00 00 00 00  02 78 78 
39 01 00 00 00 00  02 79 00 
39 01 00 00 00 00  02 7A A4 
39 01 00 00 00 00  02 7B 00 
39 01 00 00 00 00  02 7C C2 
39 01 00 00 00 00  02 7D 00 
39 01 00 00 00 00  02 7E DA 
39 01 00 00 00 00  02 7F 00 
39 01 00 00 00 00  02 80 ED 
39 01 00 00 00 00  02 81 00 
39 01 00 00 00 00  02 82 FE 
39 01 00 00 00 00  02 83 01 
39 01 00 00 00 00  02 84 0E 
39 01 00 00 00 00  02 85 01 
39 01 00 00 00 00  02 86 1B 
39 01 00 00 00 00  02 87 01 
39 01 00 00 00 00  02 88 48 
39 01 00 00 00 00  02 89 01 
39 01 00 00 00 00  02 8A 6C 
39 01 00 00 00 00  02 8B 01 
39 01 00 00 00 00  02 8C A2 
39 01 00 00 00 00  02 8D 01 
39 01 00 00 00 00  02 8E CD 
39 01 00 00 00 00  02 8F 02 
39 01 00 00 00 00  02 90 0F 
39 01 00 00 00 00  02 91 02 
39 01 00 00 00 00  02 92 42 
39 01 00 00 00 00  02 93 02 
39 01 00 00 00 00  02 94 43 
39 01 00 00 00 00  02 95 02 
39 01 00 00 00 00  02 96 71 
39 01 00 00 00 00  02 97 02 
39 01 00 00 00 00  02 98 A3 
39 01 00 00 00 00  02 99 02 
39 01 00 00 00 00  02 9A C5 
39 01 00 00 00 00  02 9B 02 
39 01 00 00 00 00  02 9C F3 
39 01 00 00 00 00  02 9D 03 
39 01 00 00 00 00  02 9E 12 
39 01 00 00 00 00  02 9F 03 
39 01 00 00 00 00  02 A0 3A 
39 01 00 00 00 00  02 A2 03 
39 01 00 00 00 00  02 A3 46 
39 01 00 00 00 00  02 A4 03 
39 01 00 00 00 00  02 A5 52 
39 01 00 00 00 00  02 A6 03 
39 01 00 00 00 00  02 A7 60 
39 01 00 00 00 00  02 A9 03 
39 01 00 00 00 00  02 AA 6E 
39 01 00 00 00 00  02 AB 03 
39 01 00 00 00 00  02 AC 7D 
39 01 00 00 00 00  02 AD 03 
39 01 00 00 00 00  02 AE 8B 
39 01 00 00 00 00  02 AF 03 
39 01 00 00 00 00  02 B0 91 
39 01 00 00 00 00  02 B1 03 
39 01 00 00 00 00  02 B2 CF 
39 01 00 00 00 00  02 B3 00 
39 01 00 00 00 00  02 B4 49 
39 01 00 00 00 00  02 B5 00 
39 01 00 00 00 00  02 B6 78 
39 01 00 00 00 00  02 B7 00 
39 01 00 00 00 00  02 B8 A4 
39 01 00 00 00 00  02 B9 00 
39 01 00 00 00 00  02 BA C2 
39 01 00 00 00 00  02 BB 00 
39 01 00 00 00 00  02 BC DA 
39 01 00 00 00 00  02 BD 00 
39 01 00 00 00 00  02 BE ED 
39 01 00 00 00 00  02 BF 00 
39 01 00 00 00 00  02 C0 FE 
39 01 00 00 00 00  02 C1 01 
39 01 00 00 00 00  02 C2 0E 
39 01 00 00 00 00  02 C3 01 
39 01 00 00 00 00  02 C4 1B 
39 01 00 00 00 00  02 C5 01 
39 01 00 00 00 00  02 C6 48 
39 01 00 00 00 00  02 C7 01 
39 01 00 00 00 00  02 C8 6C 
39 01 00 00 00 00  02 C9 01 
39 01 00 00 00 00  02 CA A2 
39 01 00 00 00 00  02 CB 01 
39 01 00 00 00 00  02 CC CD 
39 01 00 00 00 00  02 CD 02 
39 01 00 00 00 00  02 CE 0F 
39 01 00 00 00 00  02 CF 02 
39 01 00 00 00 00  02 D0 42 
39 01 00 00 00 00  02 D1 02 
39 01 00 00 00 00  02 D2 43 
39 01 00 00 00 00  02 D3 02 
39 01 00 00 00 00  02 D4 71 
39 01 00 00 00 00  02 D5 02 
39 01 00 00 00 00  02 D6 A3 
39 01 00 00 00 00  02 D7 02 
39 01 00 00 00 00  02 D8 C5 
39 01 00 00 00 00  02 D9 02 
39 01 00 00 00 00  02 DA F3 
39 01 00 00 00 00  02 DB 03 
39 01 00 00 00 00  02 DC 12 
39 01 00 00 00 00  02 DD 03 
39 01 00 00 00 00  02 DE 3A 
39 01 00 00 00 00  02 DF 03 
39 01 00 00 00 00  02 E0 46 
39 01 00 00 00 00  02 E1 03 
39 01 00 00 00 00  02 E2 52 
39 01 00 00 00 00  02 E3 03 
39 01 00 00 00 00  02 E4 60 
39 01 00 00 00 00  02 E5 03 
39 01 00 00 00 00  02 E6 6E 
39 01 00 00 00 00  02 E7 03 
39 01 00 00 00 00  02 E8 7D 
39 01 00 00 00 00  02 E9 03 
39 01 00 00 00 00  02 EA 8B 
39 01 00 00 00 00  02 EB 03 
39 01 00 00 00 00  02 EC 91 
39 01 00 00 00 00  02 ED 03 
39 01 00 00 00 00  02 EE CF 
39 01 00 00 00 00  02 EF 00 
39 01 00 00 00 00  02 F0 49 
39 01 00 00 00 00  02 F1 00 
39 01 00 00 00 00  02 F2 78 
39 01 00 00 00 00  02 F3 00 
39 01 00 00 00 00  02 F4 A4 
39 01 00 00 00 00  02 F5 00 
39 01 00 00 00 00  02 F6 C2 
39 01 00 00 00 00  02 F7 00 
39 01 00 00 00 00  02 F8 DA 
39 01 00 00 00 00  02 F9 00 
39 01 00 00 00 00  02 FA ED 
39 01 00 00 00 00  02 FF 21 
39 01 00 00 00 00  02 FB 01 
39 01 00 00 00 00  02 00 00 
39 01 00 00 00 00  02 01 FE 
39 01 00 00 00 00  02 02 01 
39 01 00 00 00 00  02 03 0E 
39 01 00 00 00 00  02 04 01 
39 01 00 00 00 00  02 05 1B 
39 01 00 00 00 00  02 06 01 
39 01 00 00 00 00  02 07 48 
39 01 00 00 00 00  02 08 01 
39 01 00 00 00 00  02 09 6C 
39 01 00 00 00 00  02 0A 01 
39 01 00 00 00 00  02 0B A2 
39 01 00 00 00 00  02 0C 01 
39 01 00 00 00 00  02 0D CD 
39 01 00 00 00 00  02 0E 02 
39 01 00 00 00 00  02 0F 0F 
39 01 00 00 00 00  02 10 02 
39 01 00 00 00 00  02 11 42 
39 01 00 00 00 00  02 12 02 
39 01 00 00 00 00  02 13 43 
39 01 00 00 00 00  02 14 02 
39 01 00 00 00 00  02 15 71 
39 01 00 00 00 00  02 16 02 
39 01 00 00 00 00  02 17 A3 
39 01 00 00 00 00  02 18 02 
39 01 00 00 00 00  02 19 C5 
39 01 00 00 00 00  02 1A 02 
39 01 00 00 00 00  02 1B F3 
39 01 00 00 00 00  02 1C 03 
39 01 00 00 00 00  02 1D 12 
39 01 00 00 00 00  02 1E 03 
39 01 00 00 00 00  02 1F 3A 
39 01 00 00 00 00  02 20 03 
39 01 00 00 00 00  02 21 46 
39 01 00 00 00 00  02 22 03 
39 01 00 00 00 00  02 23 52 
39 01 00 00 00 00  02 24 03 
39 01 00 00 00 00  02 25 60 
39 01 00 00 00 00  02 26 03 
39 01 00 00 00 00  02 27 6E 
39 01 00 00 00 00  02 28 03 
39 01 00 00 00 00  02 29 7D 
39 01 00 00 00 00  02 2A 03 
39 01 00 00 00 00  02 2B 8B 
39 01 00 00 00 00  02 2D 03 
39 01 00 00 00 00  02 2F 91 
39 01 00 00 00 00  02 30 03 
39 01 00 00 00 00  02 31 CF 
39 01 00 00 00 00  02 32 00 
39 01 00 00 00 00  02 33 49 
39 01 00 00 00 00  02 34 00 
39 01 00 00 00 00  02 35 78 
39 01 00 00 00 00  02 36 00 
39 01 00 00 00 00  02 37 A4 
39 01 00 00 00 00  02 38 00 
39 01 00 00 00 00  02 39 C2 
39 01 00 00 00 00  02 3A 00 
39 01 00 00 00 00  02 3B DA 
39 01 00 00 00 00  02 3D 00 
39 01 00 00 00 00  02 3F ED 
39 01 00 00 00 00  02 40 00 
39 01 00 00 00 00  02 41 FE 
39 01 00 00 00 00  02 42 01 
39 01 00 00 00 00  02 43 0E 
39 01 00 00 00 00  02 44 01 
39 01 00 00 00 00  02 45 1B 
39 01 00 00 00 00  02 46 01 
39 01 00 00 00 00  02 47 48 
39 01 00 00 00 00  02 48 01 
39 01 00 00 00 00  02 49 6C 
39 01 00 00 00 00  02 4A 01 
39 01 00 00 00 00  02 4B A2 
39 01 00 00 00 00  02 4C 01 
39 01 00 00 00 00  02 4D CD 
39 01 00 00 00 00  02 4E 02 
39 01 00 00 00 00  02 4F 0F 
39 01 00 00 00 00  02 50 02 
39 01 00 00 00 00  02 51 42 
39 01 00 00 00 00  02 52 02 
39 01 00 00 00 00  02 53 43 
39 01 00 00 00 00  02 54 02 
39 01 00 00 00 00  02 55 71 
39 01 00 00 00 00  02 56 02 
39 01 00 00 00 00  02 58 A3 
39 01 00 00 00 00  02 59 02 
39 01 00 00 00 00  02 5A C5 
39 01 00 00 00 00  02 5B 02 
39 01 00 00 00 00  02 5C F3 
39 01 00 00 00 00  02 5D 03 
39 01 00 00 00 00  02 5E 12 
39 01 00 00 00 00  02 5F 03 
39 01 00 00 00 00  02 60 3A 
39 01 00 00 00 00  02 61 03 
39 01 00 00 00 00  02 62 46 
39 01 00 00 00 00  02 63 03 
39 01 00 00 00 00  02 64 52 
39 01 00 00 00 00  02 65 03 
39 01 00 00 00 00  02 66 60 
39 01 00 00 00 00  02 67 03 
39 01 00 00 00 00  02 68 6E 
39 01 00 00 00 00  02 69 03 
39 01 00 00 00 00  02 6A 7D 
39 01 00 00 00 00  02 6B 03 
39 01 00 00 00 00  02 6C 8B 
39 01 00 00 00 00  02 6D 03 
39 01 00 00 00 00  02 6E 91 
39 01 00 00 00 00  02 6F 03 
39 01 00 00 00 00  02 70 CF 
39 01 00 00 00 00  02 71 00 
39 01 00 00 00 00  02 72 49 
39 01 00 00 00 00  02 73 00 
39 01 00 00 00 00  02 74 78 
39 01 00 00 00 00  02 75 00 
39 01 00 00 00 00  02 76 A4 
39 01 00 00 00 00  02 77 00 
39 01 00 00 00 00  02 78 C2 
39 01 00 00 00 00  02 79 00 
39 01 00 00 00 00  02 7A DA 
39 01 00 00 00 00  02 7B 00 
39 01 00 00 00 00  02 7C ED 
39 01 00 00 00 00  02 7D 00 
39 01 00 00 00 00  02 7E FE 
39 01 00 00 00 00  02 7F 01 
39 01 00 00 00 00  02 80 0E 
39 01 00 00 00 00  02 81 01 
39 01 00 00 00 00  02 82 1B 
39 01 00 00 00 00  02 83 01 
39 01 00 00 00 00  02 84 48 
39 01 00 00 00 00  02 85 01 
39 01 00 00 00 00  02 86 6C 
39 01 00 00 00 00  02 87 01 
39 01 00 00 00 00  02 88 A2 
39 01 00 00 00 00  02 89 01 
39 01 00 00 00 00  02 8A CD 
39 01 00 00 00 00  02 8B 02 
39 01 00 00 00 00  02 8C 0F 
39 01 00 00 00 00  02 8D 02 
39 01 00 00 00 00  02 8E 42 
39 01 00 00 00 00  02 8F 02 
39 01 00 00 00 00  02 90 43 
39 01 00 00 00 00  02 91 02 
39 01 00 00 00 00  02 92 71 
39 01 00 00 00 00  02 93 02 
39 01 00 00 00 00  02 94 A3 
39 01 00 00 00 00  02 95 02 
39 01 00 00 00 00  02 96 C5 
39 01 00 00 00 00  02 97 02 
39 01 00 00 00 00  02 98 F3 
39 01 00 00 00 00  02 99 03 
39 01 00 00 00 00  02 9A 12 
39 01 00 00 00 00  02 9B 03 
39 01 00 00 00 00  02 9C 3A 
39 01 00 00 00 00  02 9D 03 
39 01 00 00 00 00  02 9E 46 
39 01 00 00 00 00  02 9F 03 
39 01 00 00 00 00  02 A0 52 
39 01 00 00 00 00  02 A2 03 
39 01 00 00 00 00  02 A3 60 
39 01 00 00 00 00  02 A4 03 
39 01 00 00 00 00  02 A5 6E 
39 01 00 00 00 00  02 A6 03 
39 01 00 00 00 00  02 A7 7D 
39 01 00 00 00 00  02 A9 03 
39 01 00 00 00 00  02 AA 8B 
39 01 00 00 00 00  02 AB 03 
39 01 00 00 00 00  02 AC 91 
39 01 00 00 00 00  02 AD 03 
39 01 00 00 00 00  02 AE CF 
39 01 00 00 00 00  02 AF 00 
39 01 00 00 00 00  02 B0 49 
39 01 00 00 00 00  02 B1 00 
39 01 00 00 00 00  02 B2 78 
39 01 00 00 00 00  02 B3 00 
39 01 00 00 00 00  02 B4 A4 
39 01 00 00 00 00  02 B5 00 
39 01 00 00 00 00  02 B6 C2 
39 01 00 00 00 00  02 B7 00 
39 01 00 00 00 00  02 B8 DA 
39 01 00 00 00 00  02 B9 00 
39 01 00 00 00 00  02 BA ED 
39 01 00 00 00 00  02 BB 00 
39 01 00 00 00 00  02 BC FE 
39 01 00 00 00 00  02 BD 01 
39 01 00 00 00 00  02 BE 0E 
39 01 00 00 00 00  02 BF 01 
39 01 00 00 00 00  02 C0 1B 
39 01 00 00 00 00  02 C1 01 
39 01 00 00 00 00  02 C2 48 
39 01 00 00 00 00  02 C3 01 
39 01 00 00 00 00  02 C4 6C 
39 01 00 00 00 00  02 C5 01 
39 01 00 00 00 00  02 C6 A2 
39 01 00 00 00 00  02 C7 01 
39 01 00 00 00 00  02 C8 CD 
39 01 00 00 00 00  02 C9 02 
39 01 00 00 00 00  02 CA 0F 
39 01 00 00 00 00  02 CB 02 
39 01 00 00 00 00  02 CC 42 
39 01 00 00 00 00  02 CD 02 
39 01 00 00 00 00  02 CE 43 
39 01 00 00 00 00  02 CF 02 
39 01 00 00 00 00  02 D0 71 
39 01 00 00 00 00  02 D1 02 
39 01 00 00 00 00  02 D2 A3 
39 01 00 00 00 00  02 D3 02 
39 01 00 00 00 00  02 D4 C5 
39 01 00 00 00 00  02 D5 02 
39 01 00 00 00 00  02 D6 F3 
39 01 00 00 00 00  02 D7 03 
39 01 00 00 00 00  02 D8 12 
39 01 00 00 00 00  02 D9 03 
39 01 00 00 00 00  02 DA 3A 
39 01 00 00 00 00  02 DB 03 
39 01 00 00 00 00  02 DC 46 
39 01 00 00 00 00  02 DD 03 
39 01 00 00 00 00  02 DE 52 
39 01 00 00 00 00  02 DF 03 
39 01 00 00 00 00  02 E0 60 
39 01 00 00 00 00  02 E1 03 
39 01 00 00 00 00  02 E2 6E 
39 01 00 00 00 00  02 E3 03 
39 01 00 00 00 00  02 E4 7D 
39 01 00 00 00 00  02 E5 03 
39 01 00 00 00 00  02 E6 8B 
39 01 00 00 00 00  02 E7 03 
39 01 00 00 00 00  02 E8 91 
39 01 00 00 00 00  02 E9 03 
39 01 00 00 00 00  02 EA CF
//pwm设置 
39 01 00 00 00 00  02 FF 23
39 01 00 00 00 00  02 FB 01
39 01 00 00 00 00  02 07 20
39 01 00 00 00 00  02 08 03
//
39 01 00 00 00 00  02 FF 10 
39 01 00 00 00 00  02 34 00 
39 01 00 00 00 00  02 35 00 
39 01 00 00 00 00  04 3B 03 06 06 
39 01 00 00 00 00  02 BB 10

15 01 00 00 00 00 02 51 20 

15 01 00 00 00 00 02 55 00  

15 01 00 00 00 00 02 53 2C                                    
                         
05 01 00 00 78 00 02 11 00 
05 01 00 00 0a 00 02 29 00

			];
		qcom,mdss-dsi-off-command = [05 01 00 00 96 00 02 28 00
				 05 01 00 00 96 00 02 10 00];
		qcom,mdss-dsi-on-command-state = "dsi_lp_mode";
		qcom,mdss-dsi-off-command-state = "dsi_hs_mode";
		qcom,mdss-dsi-bl-pmic-control-type ="bl_ctrl_dcs"; 
		qcom,mdss-dsi-reset-sequence = <1 20>, <0 20>, <1 20>;
		//qcom,mdss-dsi-tx-eot-append;
	};
};
