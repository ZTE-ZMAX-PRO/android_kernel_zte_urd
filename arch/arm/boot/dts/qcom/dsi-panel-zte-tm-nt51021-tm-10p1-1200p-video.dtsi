/* Copyright (c) 2015, The Linux Foundation. All rights reserved.
 *
 * This program is free software; you can redistribute it and/or modify
 * it under the terms of the GNU General Public License version 2 and
 * only version 2 as published by the Free Software Foundation.
 *
 * This program is distributed in the hope that it will be useful,
 * but WITHOUT ANY WARRANTY; without even the implied warranty of
 * MERCHANTABILITY or FITNESS FOR A PARTICULAR PURPOSE.  See the
 * GNU General Public License for more details.
 */

&mdss_mdp {
	dsi_tm_nt51021_tm_10p1_1200P_video_vid: qcom,mdss_dsi_tm_nt51021_tm_10p1_1200p_video {
		qcom,mdss-dsi-panel-name = "zteTM(NT51021)TM_1920*1200_10P1Inch";
		qcom,mdss-dsi-panel-type = "dsi_video_mode";
		qcom,cont-splash-enabled;
		qcom,mdss-pan-physical-width-dimension = <135>;
		qcom,mdss-pan-physical-height-dimension = <217>;
		qcom,mdss-dsi-panel-framerate = <60>;
		qcom,mdss-dsi-virtual-channel-id = <0>;
		qcom,mdss-dsi-stream = <0>;
		qcom,mdss-dsi-panel-width = <1200>;
		qcom,mdss-dsi-panel-height = <1920>;
		qcom,mdss-dsi-h-front-porch = <80>;//bitclk:956.35M
		qcom,mdss-dsi-h-back-porch = <60>;
		qcom,mdss-dsi-h-pulse-width = <1>;
		qcom,mdss-dsi-h-sync-skew = <0>;
		qcom,mdss-dsi-v-back-porch = <25>;
		qcom,mdss-dsi-v-front-porch = <35>;
		qcom,mdss-dsi-v-pulse-width = <1>;
		qcom,mdss-dsi-h-left-border = <0>;
		qcom,mdss-dsi-h-right-border = <0>;
		qcom,mdss-dsi-v-top-border = <0>;
		qcom,mdss-dsi-v-bottom-border = <0>;
		qcom,mdss-dsi-bpp = <24>;
		qcom,mdss-dsi-underflow-color = <0xff>;
		qcom,mdss-dsi-border-color = <0>;
		qcom,mdss-dsi-h-sync-pulse = <0>;
		qcom,mdss-dsi-traffic-mode = "burst_mode";

		qcom,mdss-dsi-te-pin-select = <1>;
		qcom,mdss-dsi-te-dcs-command = <1>;
		qcom,mdss-dsi-te-check-enable;
		qcom,mdss-dsi-te-using-te-pin;
		qcom,mdss-dsi-wr-mem-start = <0x2c>;
		qcom,mdss-dsi-wr-mem-continue = <0x3c>;
		
		qcom,mdss-dsi-force-clock-lane-hs;//pan 
		
		qcom,mdss-dsi-bllp-eof-power-mode;
		qcom,mdss-dsi-bllp-power-mode;
		qcom,mdss-dsi-lane-0-state;
		qcom,mdss-dsi-lane-1-state;
		qcom,mdss-dsi-lane-2-state;
		qcom,mdss-dsi-lane-3-state;
		qcom,mdss-dsi-panel-timings = [f2 3a 28 00 6c 70 2c 3e 2e 03 04 00];
		qcom,mdss-dsi-t-clk-post = <0x0e>;
		qcom,mdss-dsi-t-clk-pre = <0x32>;
		qcom,mdss-dsi-bl-min-level = <1>;
		qcom,mdss-dsi-bl-max-level = <255>;
		qcom,mdss-dsi-dma-trigger = "trigger_sw";
		qcom,mdss-dsi-mdp-trigger = "none";
		qcom,mdss-dsi-on-command = [
			39 01 00 00 00 00 02 83 00	//page 0
			39 01 00 00 00 00 02 84 00	//page 0
			39 01 00 00 00 00 02 8C 0E
			39 01 00 00 00 00 02 90 FF
			39 01 00 00 00 00 02 91 07
			39 01 00 00 00 00 02 92 CF
			39 01 00 00 00 00 02 96 00
			39 01 00 00 00 00 02 97 00
			39 01 00 00 00 00 02 A9 2E
			39 01 00 00 00 00 02 C0 02
			39 01 00 00 00 00 02 C4 01
			39 01 00 00 00 00 02 C5 44
			39 01 00 00 00 00 02 C6 42
			39 01 00 00 00 00 02 C7 45
			39 01 00 00 00 00 02 FA 08
			39 01 00 00 00 00 02 FD 09
			
			39 01 00 00 00 00 02 83 AA
			39 01 00 00 00 00 02 84 11
			39 01 00 00 00 00 02 A9 4B
			39 01 00 00 00 00 02 C0 16
			39 01 00 00 00 00 02 C1 1B
			39 01 00 00 00 00 02 C2 28
			39 01 00 00 00 00 02 C3 34
			39 01 00 00 00 00 02 C4 3F
			39 01 00 00 00 00 02 C5 48
			39 01 00 00 00 00 02 C6 50
			39 01 00 00 00 00 02 C7 57
			39 01 00 00 00 00 02 C8 5E
			39 01 00 00 00 00 02 C9 C8
			39 01 00 00 00 00 02 CA C9
			39 01 00 00 00 00 02 CB DF
			39 01 00 00 00 00 02 CC E7
			39 01 00 00 00 00 02 CD E8
			39 01 00 00 00 00 02 CE E3
			39 01 00 00 00 00 02 CF E5
			39 01 00 00 00 00 02 D0 E6
			39 01 00 00 00 00 02 D1 F4
			39 01 00 00 00 00 02 D2 06
			39 01 00 00 00 00 02 D3 23
			39 01 00 00 00 00 02 D4 2C
			39 01 00 00 00 00 02 D5 9E
			39 01 00 00 00 00 02 D6 A6
			39 01 00 00 00 00 02 D7 AE
			39 01 00 00 00 00 02 D8 B7
			39 01 00 00 00 00 02 D9 C1
			39 01 00 00 00 00 02 DA CE
			39 01 00 00 00 00 02 DB DC
			39 01 00 00 00 00 02 DC F0
			39 01 00 00 00 00 02 DD FE
			39 01 00 00 00 00 02 DE 00
			39 01 00 00 00 00 02 DF 2E
			39 01 00 00 00 00 02 E0 16
			39 01 00 00 00 00 02 E1 1B
			39 01 00 00 00 00 02 E2 28
			39 01 00 00 00 00 02 E3 34
			39 01 00 00 00 00 02 E4 3F
			39 01 00 00 00 00 02 E5 48
			39 01 00 00 00 00 02 E6 50
			39 01 00 00 00 00 02 E7 57
			39 01 00 00 00 00 02 E8 5E
			39 01 00 00 00 00 02 E9 C8
			39 01 00 00 00 00 02 EA C9
			39 01 00 00 00 00 02 EB DF
			39 01 00 00 00 00 02 EC E7
			39 01 00 00 00 00 02 ED E8
			39 01 00 00 00 00 02 EE E3
			39 01 00 00 00 00 02 EF E5
			39 01 00 00 00 00 02 F0 E6
			39 01 00 00 00 00 02 F1 F4
			39 01 00 00 00 00 02 F2 06
			39 01 00 00 00 00 02 F3 23
			39 01 00 00 00 00 02 F4 2C
			39 01 00 00 00 00 02 F5 9E
			39 01 00 00 00 00 02 F6 A6
			39 01 00 00 00 00 02 F7 AE
			39 01 00 00 00 00 02 F8 B7
			39 01 00 00 00 00 02 F9 C1
			39 01 00 00 00 00 02 FA CE
			39 01 00 00 00 00 02 FB DC
			39 01 00 00 00 00 02 FC F0
			39 01 00 00 00 00 02 FD FE
			39 01 00 00 00 00 02 FE 00
			39 01 00 00 00 00 02 FF 2E
			
			39 01 00 00 00 00 02 83 BB
			39 01 00 00 00 00 02 84 22
			39 01 00 00 00 00 02 96 00	//pwm min 0,add 0607
			39 01 00 00 00 00 02 94 b9	//pwm 23.4k ~ 31.3k ,add 0517	
			39 01 00 00 00 00 02 90 c0	//40 enable cabc ,c0 disable cabc,add 0607
			39 01 00 00 00 00 02 95 10	//diming off,add 0607	
			39 01 00 00 00 00 02 91 80	//als diming off ,add 0607
			39 01 00 00 00 00 02 C0 16
			39 01 00 00 00 00 02 C1 1B
			39 01 00 00 00 00 02 C2 28
			39 01 00 00 00 00 02 C3 34
			39 01 00 00 00 00 02 C4 3F
			39 01 00 00 00 00 02 C5 48
			39 01 00 00 00 00 02 C6 50
			39 01 00 00 00 00 02 C7 57
			39 01 00 00 00 00 02 C8 5E
			39 01 00 00 00 00 02 C9 C8
			39 01 00 00 00 00 02 CA C9
			39 01 00 00 00 00 02 CB DF
			39 01 00 00 00 00 02 CC E7
			39 01 00 00 00 00 02 CD E8
			39 01 00 00 00 00 02 CE E3
			39 01 00 00 00 00 02 CF E5
			39 01 00 00 00 00 02 D0 E6
			39 01 00 00 00 00 02 D1 F4
			39 01 00 00 00 00 02 D2 06
			39 01 00 00 00 00 02 D3 23
			39 01 00 00 00 00 02 D4 2C
			39 01 00 00 00 00 02 D5 9E
			39 01 00 00 00 00 02 D6 A6
			39 01 00 00 00 00 02 D7 AE
			39 01 00 00 00 00 02 D8 B7
			39 01 00 00 00 00 02 D9 C1
			39 01 00 00 00 00 02 DA CE
			39 01 00 00 00 00 02 DB DC
			39 01 00 00 00 00 02 DC F0
			39 01 00 00 00 00 02 DD FE
			39 01 00 00 00 00 02 DE 00
			39 01 00 00 00 00 02 DF 2E
			39 01 00 00 00 00 02 E0 16
			39 01 00 00 00 00 02 E1 1B
			39 01 00 00 00 00 02 E2 28
			39 01 00 00 00 00 02 E3 34
			39 01 00 00 00 00 02 E4 3F
			39 01 00 00 00 00 02 E5 48
			39 01 00 00 00 00 02 E6 50
			39 01 00 00 00 00 02 E7 57
			39 01 00 00 00 00 02 E8 5E
			39 01 00 00 00 00 02 E9 C8
			39 01 00 00 00 00 02 EA C9
			39 01 00 00 00 00 02 EB DF
			39 01 00 00 00 00 02 EC E7
			39 01 00 00 00 00 02 ED E8
			39 01 00 00 00 00 02 EE E3
			39 01 00 00 00 00 02 EF E5
			39 01 00 00 00 00 02 F0 E6
			39 01 00 00 00 00 02 F1 F4
			39 01 00 00 00 00 02 F2 06
			39 01 00 00 00 00 02 F3 23
			39 01 00 00 00 00 02 F4 2C
			39 01 00 00 00 00 02 F5 9E
			39 01 00 00 00 00 02 F6 A6
			39 01 00 00 00 00 02 F7 AE
			39 01 00 00 00 00 02 F8 B7
			39 01 00 00 00 00 02 F9 C1
			39 01 00 00 00 00 02 FA CE
			39 01 00 00 00 00 02 FB DC
			39 01 00 00 00 00 02 FC F0
			39 01 00 00 00 00 02 FD FE
			39 01 00 00 00 00 02 FE 00
			39 01 00 00 00 00 02 FF 2E
			
			39 01 00 00 00 00 02 83 CC
			39 01 00 00 00 00 02 84 33
			39 01 00 00 00 00 02 C0 16
			39 01 00 00 00 00 02 C1 1B
			39 01 00 00 00 00 02 C2 28
			39 01 00 00 00 00 02 C3 34
			39 01 00 00 00 00 02 C4 3F
			39 01 00 00 00 00 02 C5 48
			39 01 00 00 00 00 02 C6 50
			39 01 00 00 00 00 02 C7 57
			39 01 00 00 00 00 02 C8 5E
			39 01 00 00 00 00 02 C9 C8
			39 01 00 00 00 00 02 CA C9
			39 01 00 00 00 00 02 CB DF
			39 01 00 00 00 00 02 CC E7
			39 01 00 00 00 00 02 CD E8
			39 01 00 00 00 00 02 CE E3
			39 01 00 00 00 00 02 CF E5
			39 01 00 00 00 00 02 D0 E6
			39 01 00 00 00 00 02 D1 F4
			39 01 00 00 00 00 02 D2 06
			39 01 00 00 00 00 02 D3 23
			39 01 00 00 00 00 02 D4 2C
			39 01 00 00 00 00 02 D5 9E
			39 01 00 00 00 00 02 D6 A6
			39 01 00 00 00 00 02 D7 AE
			39 01 00 00 00 00 02 D8 B7
			39 01 00 00 00 00 02 D9 C1
			39 01 00 00 00 00 02 DA CE
			39 01 00 00 00 00 02 DB DC
			39 01 00 00 00 00 02 DC F0
			39 01 00 00 00 00 02 DD FE
			39 01 00 00 00 00 02 DE 00
			39 01 00 00 00 00 02 DF 2E
			39 01 00 00 00 00 02 E0 16
			39 01 00 00 00 00 02 E1 1B
			39 01 00 00 00 00 02 E2 28
			39 01 00 00 00 00 02 E3 34
			39 01 00 00 00 00 02 E4 3F
			39 01 00 00 00 00 02 E5 48
			39 01 00 00 00 00 02 E6 50
			39 01 00 00 00 00 02 E7 57
			39 01 00 00 00 00 02 E8 5E
			39 01 00 00 00 00 02 E9 C8
			39 01 00 00 00 00 02 EA C9
			39 01 00 00 00 00 02 EB DF
			39 01 00 00 00 00 02 EC E7
			39 01 00 00 00 00 02 ED E8
			39 01 00 00 00 00 02 EE E3
			39 01 00 00 00 00 02 EF E5
			39 01 00 00 00 00 02 F0 E6
			39 01 00 00 00 00 02 F1 F4
			39 01 00 00 00 00 02 F2 06
			39 01 00 00 00 00 02 F3 23
			39 01 00 00 00 00 02 F4 2C
			39 01 00 00 00 00 02 F5 9E
			39 01 00 00 00 00 02 F6 A6
			39 01 00 00 00 00 02 F7 AE
			39 01 00 00 00 00 02 F8 B7
			39 01 00 00 00 00 02 F9 C1
			39 01 00 00 00 00 02 FA CE
			39 01 00 00 00 00 02 FB DC
			39 01 00 00 00 00 02 FC F0
			39 01 00 00 00 00 02 FD FE
			39 01 00 00 00 00 02 FE 00
			39 01 00 00 00 00 02 FF 2E
			
			39 01 00 00 00 00 02 83 00	//get to page0 for BL
			39 01 00 00 00 00 02 84 00	//get to page0 for BL
			39 01 00 00 00 00 02 9f 00	//als duty set 0 ,20160706
			
			//39 01 00 00 00 00 02 83 00	//bist mode
			//39 01 00 00 00 00 02 84 00
			//39 01 00 00 00 00 02 91 06
		];
		qcom,mdss-dsi-off-command = [05 01 00 00 96 00 02 28 00
				 05 01 00 00 96 00 02 10 00];
		qcom,mdss-dsi-on-command-state = "dsi_lp_mode";
		qcom,mdss-dsi-off-command-state = "dsi_hs_mode";
		qcom,mdss-dsi-bl-pmic-control-type ="bl_ctrl_dcs"; 
		qcom,mdss-dsi-reset-sequence = <1 20>, <0 20>, <1 20>;
		//qcom,mdss-dsi-tx-eot-append;
	};
};
