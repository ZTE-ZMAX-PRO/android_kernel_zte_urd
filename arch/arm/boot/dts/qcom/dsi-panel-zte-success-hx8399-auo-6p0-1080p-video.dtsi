/* Copyright (c) 2015, The Linux Foundation. All rights reserved.
 *
 * This program is free software; you can redistribute it and/or modify
 * it under the terms of the GNU General Public License version 2 and
 * only version 2 as published by the Free Software Foundation.
 *
 * This program is distributed in the hope that it will be useful,
 * but WITHOUT ANY WARRANTY; without even the implied warranty of
 * MERCHANTABILITY or FITNESS FOR A PARTICULAR PURPOSE.  See the
 * GNU General Public License for more details.
 */

&mdss_mdp {
	dsi_success_hx8399_auo_6p0_1080P_video_vid: qcom,mdss_dsi_success_hx8399_auo_6p0_1080p_video {
		qcom,mdss-dsi-panel-name = "zteSUCCESS(HX8399)AUO_1080*1920_6P0Inch";
		qcom,mdss-dsi-panel-type = "dsi_cmd_mode";
		qcom,cont-splash-enabled;
		qcom,mdss-dsi-panel-framerate = <60>;
		qcom,mdss-dsi-virtual-channel-id = <0>;
		qcom,mdss-dsi-stream = <0>;
		qcom,mdss-dsi-panel-width = <1080>;
		qcom,mdss-dsi-panel-height = <1920>;
		qcom,mdss-dsi-h-front-porch = <50>;
		qcom,mdss-dsi-h-back-porch = <30>;
		qcom,mdss-dsi-h-pulse-width = <30>;
		qcom,mdss-dsi-h-sync-skew = <0>;		
		qcom,mdss-dsi-v-front-porch = <9>;
		qcom,mdss-dsi-v-back-porch = <3>;
		qcom,mdss-dsi-v-pulse-width = <4>;
		qcom,mdss-dsi-h-left-border = <0>;
		qcom,mdss-dsi-h-right-border = <0>;
		qcom,mdss-dsi-v-top-border = <0>;
		qcom,mdss-dsi-v-bottom-border = <0>;
		qcom,mdss-dsi-bpp = <24>;
		qcom,mdss-dsi-underflow-color = <0xff>;
		qcom,mdss-dsi-border-color = <0>;
		qcom,mdss-dsi-h-sync-pulse = <0>;
		qcom,mdss-dsi-traffic-mode = "burst_mode";

		qcom,mdss-dsi-te-pin-select = <1>;
		qcom,mdss-dsi-te-dcs-command = <1>;
		qcom,mdss-dsi-te-check-enable;
		qcom,mdss-dsi-te-using-te-pin;
		qcom,mdss-dsi-wr-mem-start = <0x2c>;
		qcom,mdss-dsi-wr-mem-continue = <0x3c>;
		
		qcom,mdss-dsi-bllp-eof-power-mode;
		qcom,mdss-dsi-bllp-power-mode;
		qcom,mdss-dsi-lane-0-state;
		qcom,mdss-dsi-lane-1-state;
		qcom,mdss-dsi-lane-2-state;
		qcom,mdss-dsi-lane-3-state;
		qcom,mdss-dsi-panel-timings = [DB 34 22 00 62 66 28 36 2B 03 04 00];
		qcom,mdss-dsi-t-clk-post = <0x03>;
		qcom,mdss-dsi-t-clk-pre = <0x29>;
		qcom,mdss-dsi-bl-min-level = <1>;
		qcom,mdss-dsi-bl-max-level = <220>;//0309 modify
		qcom,mdss-dsi-dma-trigger = "trigger_sw";
		qcom,mdss-dsi-mdp-trigger = "none";
		qcom,mdss-dsi-on-command = [
		
                
		39 01 00 00 00 00  04  B9 FF 83 99


		39 01 00 00 00 00 0C B1 08 AD 8D 00 D1 23 33 11 F1 94 54


		39 01 00 00 00 00 19  B2 00 80 00 7F 05 07 62 4D 11 11 00 1c 41 00 00 08 1c 0b 62 00 09 db db 24


		39 01 00 00 00 00 2D  B4 00 FF 03 0B 58 5F 04 B4 04 B4 0B 00 00 04 00 2B 05 05 0B 00 33 0B B2 03 0B 58 5F 04 B4 04 B4 0B 00 00 04 00 2B 05 05 0B 00 03 0B B2


		//39 01 00 00 00 00 03  B6  0A  0A //set VCOM voltage

		39 01 00 00 00 00 02 BC 34 

		39 01 00 00 00 00 02  C2 08 


		39 01 00 00 00 00 02 CC 08

		39 01 00 00 00 00 02 D2 00

		39 01 00 00 00 00 25 D3 00 02 00 00 00 00 10 00 00 07 89 07 89 00 07 89 07 89 00 00 03 00 03 2f 22 05 05 03 00 00 00 05 08 00 00 0A


		39 01 00 00 00 00 21  D5 28 28 1e 1e 1f 1f 02 03 00 01 24 24 18 18 18 18 20 20 18 18 18 18 18 18 18 18 2F 2F 30 30 31 31

		39 01 00 00 00 00 21 D6 20 20 1e 1e 1f 1f 01 00 03 02 24 24 18 18 18 18 28 28 18 18 18 18 18 18 18 18 2F 2F 30 30 31 31

		39 01 00 00 00 00 31 D8 aa ba aa  AA aa ba aa AA aa aa aa AA aa aa aa AA 00 0a 2A 80 00 0a 2A 80 82 Ca aA AA 82 ca aa AA 00 00 00 00 00 00 00 00 ff ff ea bf ff ff ea BF


		39 01 00 00 00 00 2B E0 1F 31 36 26 29 35 33 44 07 0C 0E 12 14 13 14 12 18 0B 17 07 13 1F 31 36 26 29 35 33 44 07 0C 0E 12 14 13 14 12 18 0B 17 07 13

		39 01 00 00 00 00 08 C9 1F 00 0A 1E 01 1E 00   //pwm=30k

		39 01 00 00 00 00  09  BF 8F CE 18 02 00 50 00 40 //zte_tzb add to solve horizental ripples, 20160125

		15 01 00 00 00 00 02 51 00 

		15 01 00 00 00 00 02 55 10  

		15 01 00 00 00 00 02 53 2C  


		05 01 00 00 78 00 02 11 00 
		05 01 00 00 0a 00 02 29 00

			];
		qcom,mdss-dsi-off-command = [05 01 00 00 96 00 02 28 00
				 05 01 00 00 96 00 02 10 00];
		qcom,mdss-dsi-on-command-state = "dsi_lp_mode";
		qcom,mdss-dsi-off-command-state = "dsi_hs_mode";
		qcom,mdss-dsi-bl-pmic-control-type ="bl_ctrl_dcs"; 
		qcom,mdss-dsi-reset-sequence = <1 20>, <0 20>, <1 20>;
		//qcom,mdss-dsi-tx-eot-append;
	};
};
